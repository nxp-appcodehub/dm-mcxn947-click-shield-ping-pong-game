## CMakeLists.txt
```
# Copyright 2025 NXP
#
# SPDX-License-Identifier: Apache-2.0

cmake_minimum_required(VERSION 3.22.0)

include(${SdkRootDirPath}/cmake/extension/mcux.cmake)

project(lvgl_guider_bm LANGUAGES C CXX ASM PROJECT_BOARD_PORT_PATH ${board_root}/${board}/lvgl_examples/lvgl_guider_bm)

mcux_project_remove_source(
    BASE_PATH ${SdkRootDirPath}
    SOURCES examples/_boards/frdmmcxn947/board.c
            examples/_boards/frdmmcxn947/board.h
)

include(${SdkRootDirPath}/CMakeLists.txt)
# Includes del proyecto

mcux_add_include(INCLUDES
    include/
    generated/
    custom/
    linker/
)


mcux_add_source(
    SOURCES
        include/guider_customer_fonts.h
        include/lv_conf_ext.h
        include/lvgl_demo_utils.h
        include/RTE_Device.h
        include/pin_mux.h
        include/board.h
        include/__oledc_driver.h
)


mcux_convert_binary(BINARY ${APPLICATION_BINARY_DIR}/${MCUX_SDK_PROJECT_NAME}.bin)

# Fuentes principales
mcux_add_source(BASE_PATH ${CMAKE_CURRENT_LIST_DIR}
    SOURCES
        "src/__oledc_driver.c"
        "src/__oledc_hal.c"
        "src/joystick-2-click.c"
        "src/lvgl_demo_utils.c"
        "src/lvgl_guider_bm.c"
        "src/lvgl_support.c"
        "src/pin_mux.c"
        "src/board.c"
)

# Agregar LVGL 8.3.10
add_subdirectory(modules/lvgl)
target_link_libraries(${MCUX_SDK_PROJECT_NAME} PRIVATE lvgl)


file(GLOB CUSTOM_SOURCES RELATIVE ${CMAKE_CURRENT_LIST_DIR} ${CMAKE_CURRENT_LIST_DIR}/custom/*.c)
file(GLOB GENERATED_SOURCES RELATIVE ${CMAKE_CURRENT_LIST_DIR} ${CMAKE_CURRENT_LIST_DIR}/generated/*.c)

mcux_add_source(BASE_PATH ${CMAKE_CURRENT_LIST_DIR} SOURCES ${CUSTOM_SOURCES} ${GENERATED_SOURCES})


mcux_remove_armgcc_linker_script(
    BASE_PATH ${SdkRootDirPath}
    TARGETS debug release
    LINKER ${device_root}/${soc_portfolio}/${soc_series}/${device}/gcc/mcxn947_cm33_core0_flash.ld
)

mcux_add_armgcc_linker_script(
    TARGETS debug release
    LINKER linker/mcxn947_cm33_core0_flash_local.ld
)
```

## prj.conf
```kconfig
# Copyright 2025 NXP
#
# SPDX-License-Identifier: Apache-2.0
CONFIG_MCUX_PRJSEG_module.board.lvgl=y
CONFIG_LV_CONF_SKIP=n
CONFIG_LV_FONT_MONTSERRAT_16=y
CONFIG_LV_FONT_MONTSERRAT_24=y
CONFIG_LV_USE_SYSMON=y
CONFIG_LV_USE_OBSERVER=y
CONFIG_LV_USE_PERF_MONITOR=y
CONFIG_LV_USE_VGLITE_ASSERT=n
CONFIG_LV_USE_ASSERT_NULL=n
CONFIG_LV_USE_ASSERT_MALLOC=n
CONFIG_LV_USE_LOG=y
CONFIG_LV_LOG_LEVEL_ERROR=y
CONFIG_LV_CONF_MINIMAL=y
CONFIG_LV_USE_LABEL=y
CONFIG_LV_USE_THEME_DEFAULT=y

CONFIG_MCUX_COMPONENT_CMSIS_Driver_Include.SPI=y
CONFIG_MCUX_COMPONENT_CMSIS_Driver_Include.I2C=y

CONFIG_MCUX_COMPONENT_component.gpio_adapter=y

CONFIG_MCUX_COMPONENT_driver.cmsis_lpspi=y
CONFIG_MCUX_COMPONENT_driver.cmsis_lpi2c=y

CONFIG_MCUX_PRJSEG_module.board.lvgl=n
```

## include/RTE_Device.h
```c
/*
 * Copyright 2022, 2025 NXP
 *
 *
 * SPDX-License-Identifier: BSD-3-Clause
 */

#ifndef _RTE_DEVICE_H
#define _RTE_DEVICE_H

extern void LPSPI1_InitPins();
extern void LPSPI1_DeinitPins();

extern void LPI2C3_InitPins();
extern void LPI2C3_DeinitPins();

extern void LPI2C9_InitPins();
extern void LPI2C9_DeinitPins();

/*Driver name mapping.*/
/* User needs to provide the implementation of LPSPIX_GetFreq/LPSPIX_InitPins/LPSPIX_DeinitPins for the enabled LPSPI
 * instance. */
#define RTE_SPI1        1
#define RTE_SPI1_DMA_EN 0

/* SPI configuration. */
#define RTE_SPI1_PCS_TO_SCK_DELAY       0
#define RTE_SPI1_SCK_TO_PSC_DELAY       0
#define RTE_SPI1_BETWEEN_TRANSFER_DELAY 0
#define RTE_SPI1_MASTER_PCS_PIN_SEL     (kLPSPI_MasterPcs1)
#define RTE_SPI1_SLAVE_PCS_PIN_SEL      (kLPSPI_SlavePcs1)
#define RTE_SPI1_PIN_INIT               LPSPI1_InitPins
#define RTE_SPI1_PIN_DEINIT             LPSPI1_DeinitPins
#define RTE_SPI1_DMA_TX_CH              0
#define RTE_SPI1_DMA_TX_PERI_SEL        (uint16_t) kDma0RequestMuxLpFlexcomm1Tx
#define RTE_SPI1_DMA_TX_DMA_BASE        DMA0
#define RTE_SPI1_DMA_RX_CH              1
#define RTE_SPI1_DMA_RX_PERI_SEL        (uint16_t) kDma0RequestMuxLpFlexcomm1Rx
#define RTE_SPI1_DMA_RX_DMA_BASE        DMA0

//
//
//#define RTE_USART0        0
//#define RTE_USART0_DMA_EN 0
//#define RTE_USART1        0
//#define RTE_USART1_DMA_EN 0
//#define RTE_USART2        0
//#define RTE_USART2_DMA_EN 0
//#define RTE_USART3        0
//#define RTE_USART3_DMA_EN 0
//#define RTE_USART4        0
//#define RTE_USART4_DMA_EN 0
//#define RTE_USART5        0
//#define RTE_USART5_DMA_EN 0
//#define RTE_USART6        0
//#define RTE_USART6_DMA_EN 0
//#define RTE_USART7        0
//#define RTE_USART7_DMA_EN 0
//
///* USART configuration. */
//#define USART_RX_BUFFER_LEN     64
//#define USART0_RX_BUFFER_ENABLE 0
//#define USART1_RX_BUFFER_ENABLE 0
//#define USART2_RX_BUFFER_ENABLE 0
//#define USART3_RX_BUFFER_ENABLE 0
//#define USART4_RX_BUFFER_ENABLE 0
//#define USART5_RX_BUFFER_ENABLE 0
//#define USART6_RX_BUFFER_ENABLE 0
//#define USART7_RX_BUFFER_ENABLE 0
//
//#define RTE_USART0_PIN_INIT        USART0_InitPins
//#define RTE_USART0_PIN_DEINIT      USART0_DeinitPins
//#define RTE_USART0_DMA_TX_CH       5
//#define RTE_USART0_DMA_TX_DMA_BASE DMA0
//#define RTE_USART0_DMA_RX_CH       4
//#define RTE_USART0_DMA_RX_DMA_BASE DMA0
//
//#define RTE_USART1_PIN_INIT        USART1_InitPins
//#define RTE_USART1_PIN_DEINIT      USART1_DeinitPins
//#define RTE_USART1_DMA_TX_CH       7
//#define RTE_USART1_DMA_TX_DMA_BASE DMA0
//#define RTE_USART1_DMA_RX_CH       6
//#define RTE_USART1_DMA_RX_DMA_BASE DMA0
//
//#define RTE_USART2_PIN_INIT        USART2_InitPins
//#define RTE_USART2_PIN_DEINIT      USART2_DeinitPins
//#define RTE_USART2_DMA_TX_CH       8
//#define RTE_USART2_DMA_TX_DMA_BASE DMA0
//#define RTE_USART2_DMA_RX_CH       9
//#define RTE_USART2_DMA_RX_DMA_BASE DMA0
//
//#define RTE_USART3_PIN_INIT        USART3_InitPins
//#define RTE_USART3_PIN_DEINIT      USART3_DeinitPins
//#define RTE_USART3_DMA_TX_CH       10
//#define RTE_USART3_DMA_TX_DMA_BASE DMA0
//#define RTE_USART3_DMA_RX_CH       11
//#define RTE_USART3_DMA_RX_DMA_BASE DMA0
//
//#define RTE_USART4_PIN_INIT        USART4_InitPins
//#define RTE_USART4_PIN_DEINIT      USART4_DeinitPins
//#define RTE_USART4_DMA_TX_CH       13
//#define RTE_USART4_DMA_TX_DMA_BASE DMA0
//#define RTE_USART4_DMA_RX_CH       12
//#define RTE_USART4_DMA_RX_DMA_BASE DMA0
//
//#define RTE_USART5_PIN_INIT        USART5_InitPins
//#define RTE_USART5_PIN_DEINIT      USART5_DeinitPins
//#define RTE_USART5_DMA_TX_CH       15
//#define RTE_USART5_DMA_TX_DMA_BASE DMA0
//#define RTE_USART5_DMA_RX_CH       14
//#define RTE_USART5_DMA_RX_DMA_BASE DMA0
//
//#define RTE_USART6_PIN_INIT        USART6_InitPins
//#define RTE_USART6_PIN_DEINIT      USART6_DeinitPins
//#define RTE_USART6_DMA_TX_CH       17
//#define RTE_USART6_DMA_TX_DMA_BASE DMA0
//#define RTE_USART6_DMA_RX_CH       16
//#define RTE_USART6_DMA_RX_DMA_BASE DMA0
//
//#define RTE_USART7_PIN_INIT        USART7_InitPins
//#define RTE_USART7_PIN_DEINIT      USART7_DeinitPins
//#define RTE_USART7_DMA_TX_CH       19
//#define RTE_USART7_DMA_TX_DMA_BASE DMA0
//#define RTE_USART7_DMA_RX_CH       18
//#define RTE_USART7_DMA_RX_DMA_BASE DMA0

/* I2C Select, I2C0 -I2C7*/
/* User needs to provide the implementation of I2CX_GetFreq/I2CX_InitPins/I2CX_DeinitPins for the enabled I2C instance.
 */
//#define RTE_I2C0        0
//#define RTE_I2C0_DMA_EN 0
//#define RTE_I2C1        0
//#define RTE_I2C1_DMA_EN 0
//#define RTE_I2C2        0
//#define RTE_I2C2_DMA_EN 0
#define RTE_I2C3        1
#define RTE_I2C3_DMA_EN 0
//#define RTE_I2C4        0
//#define RTE_I2C4_DMA_EN 0
//#define RTE_I2C5        0
//#define RTE_I2C5_DMA_EN 0
//#define RTE_I2C6        0
//#define RTE_I2C6_DMA_EN 0
//#define RTE_I2C7        0
//#define RTE_I2C7_DMA_EN 0
#define RTE_I2C9        1
#define RTE_I2C9_DMA_EN 0

/*I2C configuration*/
#define RTE_I2C3_PIN_INIT        LPI2C3_InitPins
#define RTE_I2C3_PIN_DEINIT      LPI2C3_DeinitPins

#define RTE_I2C9_PIN_INIT        LPI2C9_InitPins
#define RTE_I2C9_PIN_DEINIT      LPI2C9_DeinitPins
//
//#define RTE_I2C0_Master_DMA_BASE DMA0
//#define RTE_I2C0_Master_DMA_CH   1
//
//#define RTE_I2C1_Master_DMA_BASE DMA0
//#define RTE_I2C1_Master_DMA_CH   3
//
//#define RTE_I2C2_Master_DMA_BASE DMA0
//#define RTE_I2C2_Master_DMA_CH   5

#define RTE_I2C3_Master_DMA_BASE DMA0
#define RTE_I2C3_Master_DMA_CH   7

//#define RTE_I2C4_Master_DMA_BASE DMA0
//#define RTE_I2C4_Master_DMA_CH   9
//
//#define RTE_I2C5_Master_DMA_BASE DMA0
//#define RTE_I2C5_Master_DMA_CH   11
//
//#define RTE_I2C6_Master_DMA_BASE DMA0
//#define RTE_I2C6_Master_DMA_CH   13
//
//#define RTE_I2C7_Master_DMA_BASE DMA0
//#define RTE_I2C7_Master_DMA_CH   15

#define RTE_I2C9_Master_DMA_BASE DMA0
#define RTE_I2C9_Master_DMA_CH   19


#endif /* _RTE_DEVICE_H */
```

## include/__oledc_driver.h
```c
/*
    __oledc_driver.h

-----------------------------------------------------------------------------

  This file is part of mikroSDK.
  
  Copyright (c) 2017, MikroElektonika - http://www.mikroe.com

  All rights reserved.

----------------------------------------------------------------------------- */

/**
@file   __oledc_driver.h
@brief    OLED_C Driver
@mainpage OLED_C Click
@{

@image html libstock_fb_view.jpg

@}

@defgroup   OLEDC
@brief      OLED_C Click Driver
@{

| Global Library Prefix | **OLEDC** |
|:---------------------:|:-----------------:|
| Version               | **1.0.0**    |
| Date                  | **Jan 2018.**      |
| Developer             | **MikroE Team**     |

*/
/* -------------------------------------------------------------------------- */

#include "stdint.h"
#include "stdbool.h"

#ifndef _OLEDC_H_
#define _OLEDC_H_

/** 
 * @macro T_OLEDC_P
 * @brief Driver Abstract type 
 */
#define T_OLEDC_P    const uint8_t*

/** @defgroup OLEDC_COMPILE Compilation Config */              /** @{ */

   #define   __OLEDC_DRV_SPI__                            /**<     @macro __OLEDC_DRV_SPI__  @brief SPI driver selector */
//  #define   __OLEDC_DRV_I2C__                            /**<     @macro __OLEDC_DRV_I2C__  @brief I2C driver selector */                                          
// #define   __OLEDC_DRV_UART__                           /**<     @macro __OLEDC_DRV_UART__ @brief UART driver selector */ 

                                                                       /** @} */
/** @defgroup OLEDC_VAR Variables */                           /** @{ */

///@}
/**
 * @name                 Font Direction
 ******************************************************************************/
///@{
extern const uint8_t  _OLEDC_FO_HORIZONTAL;
extern const uint8_t  _OLEDC_FO_VERTICAL;
extern const uint8_t  _OLEDC_FO_VERTICAL_COLUMN;

/**
 * @name                 Remamp set
 ******************************************************************************/
///@{
extern const uint8_t _OLEDC_RMP_INC_HOR;
extern const uint8_t _OLEDC_RMP_INC_VER;
extern const uint8_t _OLEDC_RMP_COLOR_NOR;
extern const uint8_t _OLEDC_RMP_COLOR_REV;
extern const uint8_t _OLEDC_RMP_SEQ_RGB;
extern const uint8_t _OLEDC_RMP_SEQ_BGR;
extern const uint8_t _OLEDC_RMP_SCAN_NOR;
extern const uint8_t _OLEDC_RMP_SCAN_REV;
extern const uint8_t _OLEDC_RMP_SPLIT_DISABLE;
extern const uint8_t _OLEDC_RMP_SPLIT_ENABLE;
extern const uint8_t _OLEDC_COLOR_65K;
extern const uint8_t _OLEDC_COLOR_262K;
extern const uint8_t _OLED_C_IMG_HEAD;

/**
 * @name                 Device Properties
 ******************************************************************************/
///@{
extern const uint8_t  _OLEDC_SCREEN_WIDTH;
extern const uint8_t  _OLEDC_SCREEN_HEIGHT;
extern const uint16_t _OLEDC_SCREEN_SIZE;  
extern const uint8_t  _OLEDC_ROW_OFF;
extern const uint8_t  _OLEDC_COL_OFF;

///@}
/**
 * @name                 SSD1355 Commands
 ******************************************************************************/
///@{
extern const uint8_t  _OLEDC_SET_COL_ADDRESS;
extern const uint8_t  _OLEDC_SET_ROW_ADDRESS;
extern const uint8_t  _OLEDC_WRITE_RAM;
extern const uint8_t  _OLEDC_READ_RAM;
extern const uint8_t  _OLEDC_SET_REMAP;
extern const uint8_t  _OLEDC_SET_START_LINE;
extern const uint8_t  _OLEDC_SET_OFFSET;
extern const uint8_t  _OLEDC_MODE_OFF;
extern const uint8_t  _OLEDC_MODE_ON;
extern const uint8_t  _OLEDC_MODE_NORMAL;
extern const uint8_t  _OLEDC_MODE_INVERSE;
extern const uint8_t  _OLEDC_FUNCTION;
extern const uint8_t  _OLEDC_SLEEP_ON;
extern const uint8_t  _OLEDC_SLEEP_OFF;
extern const uint8_t  _OLED_C_NOP;
extern const uint8_t  _OLED_C_SET_RESET_PRECH;
extern const uint8_t  _OLED_C_ENHANCEMENT;
extern const uint8_t  _OLEDC_CLOCK_DIV;
extern const uint8_t  _OLEDC_VSL;
extern const uint8_t  _OLEDC_GPIO;
extern const uint8_t  _OLEDC_SETSEC_PRECH;
extern const uint8_t  _OLEDC_GREY_SCALE;
extern const uint8_t  _OLEDC_LUT;
extern const uint8_t  _OLEDC_PRECH_VOL;
extern const uint8_t  _OLEDC_VCOMH;
extern const uint8_t  _OLEDC_CONTRAST;
extern const uint8_t  _OLEDC_MASTER_CONTRAST;
extern const uint8_t  _OLEDC_MUX_RATIO;
extern const uint8_t  _OLEDC_COMMAND_LOCK;
extern const uint8_t  _OLEDC_SCROLL_HOR;
extern const uint8_t  _OLEDC_START_MOV;
extern const uint8_t  _OLEDC_STOP_MOV;





                                                                       /** @} */

#ifdef __cplusplus
extern "C"{
#endif

/** @defgroup OLEDC_INIT Driver Initialization */              /** @{ */

#ifdef   __OLEDC_DRV_SPI__
void oledc_spiDriverInit(T_OLEDC_P gpioObj, T_OLEDC_P spiObj);
#endif
#ifdef   __OLEDC_DRV_I2C__
void oledc_i2cDriverInit(T_OLEDC_P gpioObj, T_OLEDC_P i2cObj, uint8_t slave);
#endif
#ifdef   __OLEDC_DRV_UART__
void oledc_uartDriverInit(T_OLEDC_P gpioObj, T_OLEDC_P uartObj);
#endif


void flush( uint8_t start_col, uint8_t start_row, uint8_t end_col, uint8_t end_row, const uint8_t *data,uint16_t len);
void scroll();


// GPIO Only Drivers - remove in other cases
void oledc_gpioDriverInit(T_OLEDC_P gpioObj);
       
                                                                /** @} */
                                                                                                                                
/** @defgroup OLEDC_FUNC Driver Functions */                   /** @{ */

/**
 * @brief OLED C Initialization
 *
 * Function initializes function pointers and perform setup of the SSD1351
 * must be called first
 */
void oledc_init( void );

/**
 * @brief OLED C Hardware Reset
 *
 * Performs hardware reset of the click board. Init function calling executin
 * of this function.
 */
void oledc_reset( void );

/**
 * @brief OLED C Enable
 *
 * @param[in] state ( 1 ON / 0 OFF )
 *
 * Enable or disable the display usinf EN pin on the clickboard.
 */
void oledc_enable( uint8_t state );

/**
 * @brief OLED C Command
 *
 * @param[in] command   valid command
 * @param[in] args      pointer to command argument
 * @param[in] args_len  arguments size in bytes
 *
 * Executes provided comman.
 */
void oledc_command( uint8_t command, uint8_t *args, uint16_t args_len );

/**
 * @brief OLED C Fill Scren
 *
 * @param[in] color     RGB color
 *
 * Fills whole screen with provided color.
 */
void oledc_fill_screen( uint16_t color );

/**
 * @brief OLED C Draw Rectangle
 *
 * @param[in] col_off   column offset from the left border of the screen
 * @param[in] row_off   row offset from the top border of the screen
 * @param[in] col_end   column end offset also counted from the left border
 * @param[in] row_end   row offset also counted from the top border
 * @param[in] color     RGB color
 *
 * Function allows you to draw retcangles which can be used to draw lines
 * clean specific regions of the screen.
 */
void oledc_rectangle( uint8_t col_off, uint8_t row_off,
                       uint8_t col_end, uint8_t row_end, uint16_t color );

/**
 * @brief OLED C Draw BMP Image
 *
 * @param[in] col_off   column offset from the left border of the screen
 * @param[in] row_off   row offset from the top border of the screen
 * @param[in] img       pointer to bmp image
 *
 * Function draws image on the screen. Provided image must be in .bmp format
 * with 6 bytes header size. Providing image of any other format may result in
 * unpredictable behaviour.
 */
void oledc_image( const uint8_t *img, uint8_t column_off, uint8_t row_off );

/**
 * @brief OLED C Draw Text
 *
 * @param[in] text      text string
 * @param[in] col_off   column offset from the left border of the screen
 * @param[in] row_off   row offset from the top border of the screen
 *
 * Function writes text on the screen.
 */

//void oledc_text( uint8_t *text, uint16_t col_off, uint16_t row_off );
void oledc_text( char *text, uint16_t x, uint16_t y  );
/**
 * @brief OLED C Font Setup
 *
 * @param[in] font          pointer to font definition
 * @param[in] color         text color
 * @param[in] orientation   text orientation
 *
 * Function setup the parameters needed for @c oled_c_text. Before first usage
 * of @c oled_c_text it is needed to call this function and setup all
 * parameters.
 */
void oledc_set_font( const uint8_t *font, uint16_t color, uint8_t orientation );





                                                                       /** @} */
#ifdef __cplusplus
} // extern "C"
#endif
#endif

/**
    @example Click_OLED_C_STM.c
    @example Click_OLED_C_TIVA.c
    @example Click_OLED_C_CEC.c
    @example Click_OLED_C_KINETIS.c
    @example Click_OLED_C_MSP.c
    @example Click_OLED_C_PIC.c
    @example Click_OLED_C_PIC32.c
    @example Click_OLED_C_DSPIC.c
    @example Click_OLED_C_AVR.c
    @example Click_OLED_C_FT90x.c
    @example Click_OLED_C_STM.mbas
    @example Click_OLED_C_TIVA.mbas
    @example Click_OLED_C_CEC.mbas
    @example Click_OLED_C_KINETIS.mbas
    @example Click_OLED_C_MSP.mbas
    @example Click_OLED_C_PIC.mbas
    @example Click_OLED_C_PIC32.mbas
    @example Click_OLED_C_DSPIC.mbas
    @example Click_OLED_C_AVR.mbas
    @example Click_OLED_C_FT90x.mbas
    @example Click_OLED_C_STM.mpas
    @example Click_OLED_C_TIVA.mpas
    @example Click_OLED_C_CEC.mpas
    @example Click_OLED_C_KINETIS.mpas
    @example Click_OLED_C_MSP.mpas
    @example Click_OLED_C_PIC.mpas
    @example Click_OLED_C_PIC32.mpas
    @example Click_OLED_C_DSPIC.mpas
    @example Click_OLED_C_AVR.mpas
    @example Click_OLED_C_FT90x.mpas
*/                                                                     /** @} */
/* -------------------------------------------------------------------------- */
/*
  __oledc_driver.h

  Copyright (c) 2017, MikroElektonika - http://www.mikroe.com

  All rights reserved.

Redistribution and use in source and binary forms, with or without
modification, are permitted provided that the following conditions are met:

1. Redistributions of source code must retain the above copyright
   notice, this list of conditions and the following disclaimer.

2. Redistributions in binary form must reproduce the above copyright
   notice, this list of conditions and the following disclaimer in the
   documentation and/or other materials provided with the distribution.

3. All advertising materials mentioning features or use of this software
   must display the following acknowledgement:
   This product includes software developed by the MikroElektonika.

4. Neither the name of the MikroElektonika nor the
   names of its contributors may be used to endorse or promote products
   derived from this software without specific prior written permission.

THIS SOFTWARE IS PROVIDED BY MIKROELEKTRONIKA ''AS IS'' AND ANY
EXPRESS OR IMPLIED WARRANTIES, INCLUDING, BUT NOT LIMITED TO, THE IMPLIED
WARRANTIES OF MERCHANTABILITY AND FITNESS FOR A PARTICULAR PURPOSE ARE
DISCLAIMED. IN NO EVENT SHALL MIKROELEKTRONIKA BE LIABLE FOR ANY
DIRECT, INDIRECT, INCIDENTAL, SPECIAL, EXEMPLARY, OR CONSEQUENTIAL DAMAGES
(INCLUDING, BUT NOT LIMITED TO, PROCUREMENT OF SUBSTITUTE GOODS OR SERVICES;
LOSS OF USE, DATA, OR PROFITS; OR BUSINESS INTERRUPTION) HOWEVER CAUSED AND
ON ANY THEORY OF LIABILITY, WHETHER IN CONTRACT, STRICT LIABILITY, OR TORT
(INCLUDING NEGLIGENCE OR OTHERWISE) ARISING IN ANY WAY OUT OF THE USE OF THIS
SOFTWARE, EVEN IF ADVISED OF THE POSSIBILITY OF SUCH DAMAGE.

----------------------------------------------------------------------------- */
```

## include/lvgl_support.h
```c
/*
 * Copyright 2023, 2025 NXP
 *
 * SPDX-License-Identifier: BSD-3-Clause
 */

#ifndef LVGL_SUPPORT_H
#define LVGL_SUPPORT_H

#include <stdint.h>

/*******************************************************************************
 * Definitions
 ******************************************************************************/
#ifndef BOARD_USE_FLEXIO_SMARTDMA
#define BOARD_USE_FLEXIO_SMARTDMA 0
#endif

#ifndef BOARD_LCD_S035
#define BOARD_LCD_S035 0
#endif

#if BOARD_LCD_S035
#define LCD_WIDTH  480
#define LCD_HEIGHT 320
#else
#define LCD_WIDTH  96
#define LCD_HEIGHT 96
#endif

#define LCD_FB_BYTE_PER_PIXEL 2
/* The virtual buffer for DBI panel, it should be ~1/10 screen size. */
#define LCD_VIRTUAL_BUF_HEIGHT (LCD_HEIGHT )
#define LCD_VIRTUAL_BUF_SIZE   (LCD_WIDTH * LCD_VIRTUAL_BUF_HEIGHT)

/* LCD panel. */
#define BOARD_LCD_RST_GPIO GPIO4
#define BOARD_LCD_RST_PIN  7
#define BOARD_LCD_TE_GPIO  GPIO0
#define BOARD_LCD_TE_PIN   13
#define BOARD_LCD_CS_GPIO  GPIO0
#define BOARD_LCD_CS_PIN   12
#define BOARD_LCD_RS_GPIO  GPIO0
#define BOARD_LCD_RS_PIN   7
#define BOARD_LCD_INT_PORT PORT4
#define BOARD_LCD_INT_GPIO GPIO4
#define BOARD_LCD_INT_PIN  6

/*******************************************************************************
 * API
 ******************************************************************************/

#ifdef __cplusplus
extern "C" {
#endif

void lv_port_pre_init(void);
void lv_port_disp_init(void);
void lv_port_indev_init(void);

#if defined(__cplusplus)
}
#endif

#endif /*LVGL_SUPPORT_H */
```

## src/__oledc_driver.c
```c
/*
    __oledc_driver.c

-----------------------------------------------------------------------------

  This file is part of mikroSDK.

  Copyright (c) 2017, MikroElektonika - http://www.mikroe.com

  All rights reserved.

----------------------------------------------------------------------------- */

#include "__oledc_driver.h"
#include "__oledc_hal.c"
#include "fsl_adapter_gpio.h"
#include "fsl_clock.h"

/* ------------------------------------------------------------------- MACROS */
GPIO_HANDLE_DEFINE(dc_gpio_handle);
GPIO_HANDLE_DEFINE(rst_gpio_handle);
GPIO_HANDLE_DEFINE(int_gpio_handle);

// Font Direction
const uint8_t  _OLEDC_FO_HORIZONTAL       = 0x00;
const uint8_t  _OLEDC_FO_VERTICAL         = 0x01;
const uint8_t  _OLEDC_FO_VERTICAL_COLUMN  = 0x02;

// OLED REMAMP SET
const uint8_t _OLEDC_RMP_INC_HOR         = 0x00;
const uint8_t _OLEDC_RMP_INC_VER         = 0x01;
const uint8_t _OLEDC_RMP_COLOR_NOR       = 0x00;
const uint8_t _OLEDC_RMP_COLOR_REV       = 0x02;
const uint8_t _OLEDC_RMP_SEQ_RGB         = 0x00;
const uint8_t _OLEDC_RMP_SEQ_BGR         = 0x04;
const uint8_t _OLEDC_RMP_SCAN_NOR        = 0x00;
const uint8_t _OLEDC_RMP_SCAN_REV        = 0x10;
const uint8_t _OLEDC_RMP_SPLIT_DISABLE   = 0x00;
const uint8_t _OLEDC_RMP_SPLIT_ENABLE    = 0x20;
const uint8_t _OLEDC_COLOR_65K           = 0x00;
const uint8_t _OLEDC_COLOR_262K          = 0x80;
const uint8_t _OLEDC_IMG_HEAD            = 0x06;

// Device Properties
const uint8_t  _OLEDC_SCREEN_WIDTH    = 0x60;
const uint8_t  _OLEDC_SCREEN_HEIGHT   = 0x60;
const uint16_t _OLEDC_SCREEN_SIZE     = 0x2400;
const uint8_t  _OLEDC_ROW_OFF         = 0x00;
const uint8_t  _OLEDC_COL_OFF         = 0x10;

// SSD1355 Commands
const uint8_t  _OLEDC_SET_COL_ADDRESS   = 0x15;
const uint8_t  _OLEDC_SET_ROW_ADDRESS   = 0x75;
const uint8_t  _OLEDC_WRITE_RAM         = 0x5C;
const uint8_t  _OLEDC_READ_RAM          = 0x5D;
const uint8_t  _OLEDC_SET_REMAP         = 0xA0;
const uint8_t  _OLEDC_SET_START_LINE    = 0xA1;
const uint8_t  _OLEDC_SET_OFFSET        = 0xA2;
const uint8_t  _OLEDC_MODE_OFF          = 0xA4;
const uint8_t  _OLEDC_MODE_ON           = 0xA5;
const uint8_t  _OLEDC_MODE_NORMAL       = 0xA6;
const uint8_t  _OLEDC_MODE_INVERSE      = 0xA7;
const uint8_t  _OLEDC_FUNCTION          = 0xAB;
const uint8_t  _OLEDC_SLEEP_ON          = 0xAE;
const uint8_t  _OLEDC_SLEEP_OFF         = 0xAF;
const uint8_t  _OLEDC_NOP              = 0xB0;
const uint8_t  _OLEDC_SET_RESET_PRECH  = 0xB1;
const uint8_t  _OLEDC_ENHANCEMENT      = 0xB2;
const uint8_t  _OLEDC_CLOCK_DIV         = 0xB3;
const uint8_t  _OLEDC_VSL               = 0xB4;
const uint8_t  _OLEDC_GPIO              = 0xB5;
const uint8_t  _OLEDC_SETSEC_PRECH      = 0xB6;
const uint8_t  _OLEDC_GREY_SCALE        = 0xB8;
const uint8_t  _OLEDC_LUT               = 0xB9;
const uint8_t  _OLEDC_PRECH_VOL         = 0xBB;
const uint8_t  _OLEDC_VCOMH             = 0xBE;
const uint8_t  _OLEDC_CONTRAST          = 0xC1;
const uint8_t  _OLEDC_MASTER_CONTRAST   = 0xC7;
const uint8_t  _OLEDC_MUX_RATIO         = 0xCA;
const uint8_t  _OLEDC_COMMAND_LOCK      = 0xFD;
const uint8_t  _OLEDC_SCROLL_HOR        = 0x96;
const uint8_t  _OLEDC_START_MOV         = 0x9F;
const uint8_t  _OLEDC_STOP_MOV          = 0x9E;


static uint8_t _OLEDC_DEFAULT_MUX_RATIO      = 95;//95
static uint8_t _OLEDC_DEFAULT_START_LINE     = 0x80;//0x80
static uint8_t _OLEDC_DEFAULT_OFFSET         = 0x20;//0x20

static uint8_t _OLEDC_DEFAULT_OLED_LOCK      = 0x12;
static uint8_t _OLEDC_DEFAULT_CMD_LOCK       = 0xB1;
static uint8_t _OLEDC_DEFAULT_DIVSET         = 0xF1;
static uint8_t _OLEDC_DEFAULT_PRECHARGE      = 0x32;
static uint8_t _OLEDC_DEFAULT_VCOMH          = 0x05;
static uint8_t _OLEDC_DEFAULT_MASTER_CONT    = 0xCF;
static uint8_t _OLEDC_DEFAULT_PRECHARGE_2    = 0x01;

static uint8_t cols[ 2 ]    = { _OLEDC_COL_OFF, _OLEDC_COL_OFF + 95 };
static uint8_t rows[ 2 ]    = { _OLEDC_ROW_OFF, _OLEDC_ROW_OFF + 95 };

static uint8_t _OLEDC_DEFAULT_REMAP = _OLEDC_RMP_INC_HOR | _OLEDC_RMP_COLOR_REV |
                                _OLEDC_RMP_SEQ_RGB | _OLEDC_RMP_SCAN_REV |
                                _OLEDC_RMP_SPLIT_ENABLE | _OLEDC_COLOR_65K;

static  uint8_t _OLEDC_DEFAULT_VSL[ 3 ]       = { 0xA0, 0xB5, 0x55 };
static  uint8_t _OLEDC_DEFAULT_CONTRAST[ 3 ]  = { 0x8A, 0x51, 0x8A };

static  uint8_t _OLED_SCROLL[5]={ 0x01, 0x00, 0x80, 0x00, 0x00};

/* ---------------------------------------------------------------- VARIABLES */

#ifdef   __OLEDC_DRV_I2C__
static uint8_t _slaveAddress;
#endif

static const uint8_t*   _font;
static uint16_t         _font_color;
static uint8_t          _font_orientation;
static uint16_t         _font_first_char;
static uint16_t         _font_last_char;
static uint16_t         _font_height;
static uint16_t         x_cord;
static uint16_t         y_cord;

/* -------------------------------------------- PRIVATE FUNCTION DECLARATIONS */


static void pixel( uint8_t col, uint8_t row, uint16_t color );

static void character( uint16_t ch );

static void box_area( uint8_t start_col, uint8_t start_row,
                      uint8_t end_col, uint8_t end_row,
                      uint16_t color );

static void draw_area( uint8_t start_col, uint8_t start_row,
                       uint8_t end_col, uint8_t end_row,
                       const uint8_t *img );
                                           

/* --------------------------------------------- PRIVATE FUNCTION DEFINITIONS */
void flush( uint8_t start_col, uint8_t start_row, uint8_t end_col, uint8_t end_row, const uint8_t *data, uint16_t len)
{
	uint16_t    tmp  = 0;
	uint8_t     cmd  = _OLEDC_WRITE_RAM;
	uint8_t     frb  = 0;
	uint8_t     srb  = 0;
//	uint16_t    cnt  = ( end_col - start_col ) * ( end_row - start_row );
	uint16_t    cnt  = len;

//	const uint8_t*  ptr = data;

	if( ( start_col > _OLEDC_SCREEN_WIDTH ) ||
		( end_col > _OLEDC_SCREEN_WIDTH ) )
		return;

	if( ( start_row > _OLEDC_SCREEN_HEIGHT ) ||
		( end_row > _OLEDC_SCREEN_HEIGHT ) )
		return;

	if( ( end_col < start_col ) ||
		( end_row < start_row ) )
		return;

	cols[ 0 ] = _OLEDC_COL_OFF + start_col;
	cols[ 1 ] = _OLEDC_COL_OFF + end_col ;
	rows[ 0 ] = _OLEDC_ROW_OFF + start_row;
	rows[ 1 ] = _OLEDC_ROW_OFF + end_row ;

	oledc_command( _OLEDC_SET_COL_ADDRESS, cols, 2 );
	oledc_command( _OLEDC_SET_ROW_ADDRESS, rows, 2 );

	HAL_GpioSetOutput(dc_gpio_handle, 0);

	hal_spiWrite( &cmd, 1 );
	HAL_GpioSetOutput(dc_gpio_handle, 1);

	hal_spiWrite(data, cnt*2);

}
void scroll(){

	oledc_command( _OLEDC_START_MOV,       _OLED_SCROLL,        5 );

}
static void pixel( uint8_t col, uint8_t row, uint16_t color )
{
    uint8_t cmd       = _OLEDC_WRITE_RAM;
    uint8_t clr[ 2 ]  = { 0 };

    if( ( col > _OLEDC_SCREEN_WIDTH ) || ( row > _OLEDC_SCREEN_HEIGHT ) )
        return;

    cols[ 0 ] = _OLEDC_COL_OFF + col;
    cols[ 1 ] = _OLEDC_COL_OFF + col;
    rows[ 0 ] = _OLEDC_ROW_OFF + row;
    rows[ 1 ] = _OLEDC_ROW_OFF + row;
    clr[ 0 ] |= color >> 8;
    clr[ 1 ] |= color & 0x00FF;

    oledc_command( _OLEDC_SET_COL_ADDRESS, cols, 2 );
    oledc_command( _OLEDC_SET_ROW_ADDRESS, rows, 2 );
    
    HAL_GpioSetOutput(dc_gpio_handle, 0);

    hal_spiWrite( &cmd, 1 ); 
    HAL_GpioSetOutput(dc_gpio_handle, 1);

    hal_spiWrite( clr, 2 );  
}

static void character( uint16_t ch )
{
    uint8_t     ch_width = 0;
    uint8_t     x_cnt;
    uint8_t     y_cnt;
    uint16_t    x = 0;
    uint16_t    y = 0;
    uint16_t    tmp;
    uint8_t     temp = 0;
    uint8_t     mask = 0;
    uint32_t    offset;
    const uint8_t *ch_table;
    const uint8_t *ch_bitmap;

    if( ch < _font_first_char )
        return;

    if( ch > _font_last_char )
        return;

    offset = 0;
    tmp = (ch - _font_first_char) << 2;
    ch_table = _font + 8 + tmp;
    ch_width = *ch_table;

    offset = (uint32_t)ch_table[1] + ((uint32_t)ch_table[2] << 8) + ((uint32_t)ch_table[3] << 16);

    ch_bitmap = _font + offset;

    if( ( _font_orientation == _OLEDC_FO_HORIZONTAL ) ||
        ( _font_orientation == _OLEDC_FO_VERTICAL_COLUMN ) )
    {
        y = y_cord;
        for (y_cnt = 0; y_cnt < _font_height; y_cnt++)
        {
            x = x_cord;
            mask = 0;
            for( x_cnt = 0; x_cnt < ch_width; x_cnt++ )
            {
                if( !mask )
                {
                    temp = *ch_bitmap++;
                    mask = 0x01;
                }

                if( temp & mask )
                    pixel( x, y, _font_color );

                x++;
                mask <<= 1;
            }
            y++;
        }

        if ( _font_orientation == _OLEDC_FO_HORIZONTAL )
            x_cord = x + 1;
        else
            y_cord = y;
    }
    else
    {
        y = x_cord;

        for( y_cnt = 0; y_cnt < _font_height; y_cnt++ )
        {
            x = y_cord;
            mask = 0;

            for( x_cnt = 0; x_cnt < ch_width; x_cnt++ )
            {
                if( mask == 0 )
                {
                    temp = *ch_bitmap++;
                    mask = 0x01;
                }

                if( temp & mask )
                {
                    pixel( y, x, _font_color );
                }

                x--;
                mask <<= 1;
            }
            y++;
        }
        y_cord = x - 1;
    }
}


static void box_area( uint8_t start_col, uint8_t start_row, uint8_t end_col, uint8_t end_row, uint16_t color )
{
    uint8_t   cmd       = _OLEDC_WRITE_RAM;
    uint16_t  cnt       = ( end_col - start_col ) * ( end_row - start_row );
    uint8_t   clr[ 2 ]  = { 0 };
    uint8_t buff[18432];
    if( ( start_col > _OLEDC_SCREEN_WIDTH ) ||
        ( end_col > _OLEDC_SCREEN_WIDTH ) )
        return;

    if( ( start_row > _OLEDC_SCREEN_HEIGHT ) ||
        ( end_row > _OLEDC_SCREEN_HEIGHT ) )
        return;

    if( ( end_col < start_col ) ||
        ( end_row < start_row ) )
        return;

    cols[ 0 ] = _OLEDC_COL_OFF + start_col;
    cols[ 1 ] = _OLEDC_COL_OFF + end_col - 1;
    rows[ 0 ] = _OLEDC_ROW_OFF + start_row;
    rows[ 1 ] = _OLEDC_ROW_OFF + end_row - 1;
    clr[ 0 ] |= color >> 8;
    clr[ 1 ] |= color & 0x00FF;

    for(int i=0;i<(cnt*2);i+=2){
    	 buff[i] = color >> 8;
    	 buff[i+1] = color & 0x00FF;
    }


    oledc_command( _OLEDC_SET_COL_ADDRESS, cols, 2 );
    oledc_command( _OLEDC_SET_ROW_ADDRESS, rows, 2 );

    HAL_GpioSetOutput(dc_gpio_handle, 0);

    hal_spiWrite( &cmd, 1 ); 
    HAL_GpioSetOutput(dc_gpio_handle, 1);

	hal_spiWrite( buff, cnt*2 );

}

static void draw_area( uint8_t start_col, uint8_t start_row, uint8_t end_col, uint8_t end_row, const uint8_t *img )
{
    uint16_t    tmp  = 0;
    uint8_t     cmd  = _OLEDC_WRITE_RAM;
    uint8_t     frb  = 0;
    uint8_t     srb  = 0;
    uint16_t    cnt  = ( end_col - start_col ) * ( end_row - start_row );
    
    const uint8_t*  ptr = img + _OLEDC_IMG_HEAD;

    if( ( start_col > _OLEDC_SCREEN_WIDTH ) ||
        ( end_col > _OLEDC_SCREEN_WIDTH ) )
        return;

    if( ( start_row > _OLEDC_SCREEN_HEIGHT ) ||
        ( end_row > _OLEDC_SCREEN_HEIGHT ) )
        return;

    if( ( end_col < start_col ) ||
        ( end_row < start_row ) )
        return;

    cols[ 0 ] = _OLEDC_COL_OFF + start_col;
    cols[ 1 ] = _OLEDC_COL_OFF + end_col - 1;
    rows[ 0 ] = _OLEDC_ROW_OFF + start_row;
    rows[ 1 ] = _OLEDC_ROW_OFF + end_row - 1;

    oledc_command( _OLEDC_SET_COL_ADDRESS, cols, 2 );
    oledc_command( _OLEDC_SET_ROW_ADDRESS, rows, 2 );

    HAL_GpioSetOutput(dc_gpio_handle, 0);

    hal_spiWrite( &cmd, 1 );
    HAL_GpioSetOutput(dc_gpio_handle, 1);

    hal_spiWrite(ptr, cnt*2);
}


/* --------------------------------------------------------- PUBLIC FUNCTIONS */

#ifdef   __OLEDC_DRV_SPI__

void oledc_spiDriverInit(T_OLEDC_P gpioObj, T_OLEDC_P spiObj)
{

    HAL_GpioSetOutput(dc_gpio_handle, 1);

}

#endif
#ifdef   __OLEDC_DRV_I2C__

void oledc_i2cDriverInit(T_OLEDC_P gpioObj, T_OLEDC_P i2cObj, uint8_t slave)
{
    _slaveAddress = slave;
    hal_i2cMap( (T_HAL_P)i2cObj );
    hal_gpioMap( (T_HAL_P)gpioObj );

    // ... power ON
    // ... configure CHIP
}

#endif
#ifdef   __OLEDC_DRV_UART__

void oledc_uartDriverInit(T_OLEDC_P gpioObj, T_OLEDC_P uartObj)
{
    hal_uartMap( (T_HAL_P)uartObj );
    hal_gpioMap( (T_HAL_P)gpioObj );

    // ... power ON
    // ... configure CHIP
}

#endif

/* ----------------------------------------------------------- IMPLEMENTATION */

void oledc_enable( uint8_t state )
{
    HAL_GpioSetOutput(int_gpio_handle, state);

}

void oledc_reset( void )
{
	HAL_GpioSetOutput(rst_gpio_handle, 1);
//    SDK_DelayAtLeastUs(1000, CLOCK_GetMainClkFreq());
    HAL_GpioSetOutput(rst_gpio_handle, 0);
//    SDK_DelayAtLeastUs(1000, CLOCK_GetMainClkFreq());
    HAL_GpioSetOutput(rst_gpio_handle, 1);
//    SDK_DelayAtLeastUs(100000, CLOCK_GetMainClkFreq());

}


void oledc_command( uint8_t command, uint8_t *args, uint16_t args_len )
{
    uint8_t *ptr = args;

    HAL_GpioSetOutput(dc_gpio_handle, 0);
    hal_spiWrite( &command, 1 );
    HAL_GpioSetOutput(dc_gpio_handle, 1);
    if( args_len )
            hal_spiWrite( ptr, args_len );
}

void oledc_init()
{


	hal_gpio_pin_config_t 	rst_gpio_config;
	hal_gpio_pin_config_t 	dc_gpio_config;
	hal_gpio_pin_config_t 	int_gpio_config;

	CLOCK_EnableClock(kCLOCK_Port0);
	CLOCK_EnableClock(kCLOCK_Gpio0);
	rst_gpio_config.direction	= kHAL_GpioDirectionOut;
	rst_gpio_config.level		= 0;
	rst_gpio_config.port		= 0;
	rst_gpio_config.pin			= 23;
	HAL_GpioInit(rst_gpio_handle, &rst_gpio_config);

	CLOCK_EnableClock(kCLOCK_Port2);
	CLOCK_EnableClock(kCLOCK_Gpio2);
	dc_gpio_config.direction	= kHAL_GpioDirectionOut;
	dc_gpio_config.level		= 0;
	dc_gpio_config.port			= 2;
	dc_gpio_config.pin			= 7;
	HAL_GpioInit(dc_gpio_handle, &dc_gpio_config);

	CLOCK_EnableClock(kCLOCK_Port1);
	CLOCK_EnableClock(kCLOCK_Gpio1);

	int_gpio_config.direction	= kHAL_GpioDirectionOut;
	int_gpio_config.level		= 0;
	int_gpio_config.port		= 1;
	int_gpio_config.pin			= 23;
	HAL_GpioInit(int_gpio_handle, &int_gpio_config);


	oledc_enable(1);
	oledc_reset();

    /* Unlock display and turn off */
    oledc_command( _OLEDC_COMMAND_LOCK,    &_OLEDC_DEFAULT_OLED_LOCK,     1 );
    oledc_command( _OLEDC_COMMAND_LOCK,    &_OLEDC_DEFAULT_CMD_LOCK,      1 );
    oledc_command( _OLEDC_SLEEP_ON,        0,                      0 );

    /* Setup SSD1351 */
    oledc_command( _OLEDC_SET_REMAP,       &_OLEDC_DEFAULT_REMAP,         1 );
    oledc_command( _OLEDC_MUX_RATIO,       &_OLEDC_DEFAULT_MUX_RATIO,     1 );
    oledc_command( _OLEDC_SET_START_LINE,  &_OLEDC_DEFAULT_START_LINE,    1 );
    oledc_command( _OLEDC_SET_OFFSET,      &_OLEDC_DEFAULT_OFFSET,        1 );
    oledc_command( _OLEDC_VCOMH,           &_OLEDC_DEFAULT_VCOMH,         1 );
    oledc_command( _OLEDC_CLOCK_DIV,       &_OLEDC_DEFAULT_DIVSET,        1 );
    oledc_command( _OLEDC_ENHANCEMENT,       0,        0 );

    oledc_command( _OLEDC_SET_RESET_PRECH, &_OLEDC_DEFAULT_PRECHARGE,     1 );
    oledc_command( _OLEDC_SETSEC_PRECH,    &_OLEDC_DEFAULT_PRECHARGE_2,   1 );
    oledc_command( _OLEDC_MASTER_CONTRAST, &_OLEDC_DEFAULT_MASTER_CONT,   1 );
    oledc_command( _OLEDC_CONTRAST,        _OLEDC_DEFAULT_CONTRAST,       3 );
    oledc_command( _OLEDC_VSL,             _OLEDC_DEFAULT_VSL,            3 );

    /* Set normal mode and turn on display */
    oledc_command( _OLEDC_MODE_NORMAL, 0, 0 );
    oledc_command( _OLEDC_SLEEP_OFF,   0, 0 );

    oledc_fill_screen( 0 );
}


void oledc_fill_screen( uint16_t color )
{
    box_area( 0, 0, 96, 96, color );
}

void oledc_rectangle( uint8_t col_off, uint8_t row_off, uint8_t col_end, uint8_t row_end, uint16_t color )
{
    box_area( col_off, row_off, col_end, row_end, color );
}

void oledc_image( const uint8_t* img, uint8_t col_off, uint8_t row_off )
{
    const uint8_t *ptr = img;
    draw_area( col_off, row_off, col_off + ptr[2], row_off + ptr[4], ptr );
}

void oledc_text( char *text, uint16_t x, uint16_t y )
{
    uint8_t *ptr = text;

    if( ( x >= _OLEDC_SCREEN_WIDTH ) || (y >= _OLEDC_SCREEN_HEIGHT ) )
        return;

    x_cord = x;
    y_cord = y;

    while( *ptr )
        character( *ptr++ );
}

void oledc_set_font( const uint8_t *font, uint16_t color, uint8_t orientation )
{
    _font               = font;
    _font_first_char    = font[2] + (font[3] << 8);
    _font_last_char     = font[4] + (font[5] << 8);
    _font_height        = font[6];
    _font_color         = color;
    _font_orientation   = orientation ;
}

/* -------------------------------------------------------------------------- */
/*
  __oledc_driver.c

  Copyright (c) 2017, MikroElektonika - http://www.mikroe.com

  All rights reserved.

Redistribution and use in source and binary forms, with or without
modification, are permitted provided that the following conditions are met:

1. Redistributions of source code must retain the above copyright
   notice, this list of conditions and the following disclaimer.

2. Redistributions in binary form must reproduce the above copyright
   notice, this list of conditions and the following disclaimer in the
   documentation and/or other materials provided with the distribution.

3. All advertising materials mentioning features or use of this software
   must display the following acknowledgement:
   This product includes software developed by the MikroElektonika.

4. Neither the name of the MikroElektonika nor the
   names of its contributors may be used to endorse or promote products
   derived from this software without specific prior written permission.

THIS SOFTWARE IS PROVIDED BY MIKROELEKTRONIKA ''AS IS'' AND ANY
EXPRESS OR IMPLIED WARRANTIES, INCLUDING, BUT NOT LIMITED TO, THE IMPLIED
WARRANTIES OF MERCHANTABILITY AND FITNESS FOR A PARTICULAR PURPOSE ARE
DISCLAIMED. IN NO EVENT SHALL MIKROELEKTRONIKA BE LIABLE FOR ANY
DIRECT, INDIRECT, INCIDENTAL, SPECIAL, EXEMPLARY, OR CONSEQUENTIAL DAMAGES
(INCLUDING, BUT NOT LIMITED TO, PROCUREMENT OF SUBSTITUTE GOODS OR SERVICES;
LOSS OF USE, DATA, OR PROFITS; OR BUSINESS INTERRUPTION) HOWEVER CAUSED AND
ON ANY THEORY OF LIABILITY, WHETHER IN CONTRACT, STRICT LIABILITY, OR TORT
(INCLUDING NEGLIGENCE OR OTHERWISE) ARISING IN ANY WAY OUT OF THE USE OF THIS
SOFTWARE, EVEN IF ADVISED OF THE POSSIBILITY OF SUCH DAMAGE.

----------------------------------------------------------------------------- */
```
